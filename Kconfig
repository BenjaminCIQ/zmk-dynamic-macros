## Kconfig
```kconfig
DT_COMPAT_ZMK_BEHAVIOR_DYNAMIC_MACRO := zmk,behavior-dynamic-macro

config ZMK_BEHAVIOR_DYNAMIC_MACRO
    bool
    default $(dt_compat_enabled,$(DT_COMPAT_ZMK_BEHAVIOR_DYNAMIC_MACRO))

if ZMK_BEHAVIOR_DYNAMIC_MACRO

config ZMK_BEHAVIOR_DYNAMIC_MACRO_MAX_EVENTS
    int "Maximum number of events per macro slot (press + release = 2 events)"
    default 64

config ZMK_BEHAVIOR_DYNAMIC_MACRO_TAP_DELAY
    int "Delay in ms between each event during playback"
    default 30

config ZMK_BEHAVIOR_DYNAMIC_MACRO_ASSIGN_TIMEOUT
    int "Timeout in ms before pending assign/delete auto-cancels"
    default 10000

config ZMK_BEHAVIOR_DYNAMIC_MACRO_PERSIST
    bool "Persist macros to NVS flash across reboots"
    default y
    depends on SETTINGS

config ZMK_BEHAVIOR_DYNAMIC_MACRO_NVS_SLOTS
    int "Number of NVS-backed dynamic macro slots"
    default 8
    range 0 16
    depends on ZMK_BEHAVIOR_DYNAMIC_MACRO_PERSIST

config ZMK_BEHAVIOR_DYNAMIC_MACRO_RAM_SLOTS
    int "Number of RAM-only dynamic macro slots"
    default 8
    range 0 48

comment "Dynamic macro has zero slots; all dynamic macro slot bindings will be unusable"
    depends on ZMK_BEHAVIOR_DYNAMIC_MACRO_RAM_SLOTS = 0
    depends on !ZMK_BEHAVIOR_DYNAMIC_MACRO_PERSIST || ZMK_BEHAVIOR_DYNAMIC_MACRO_NVS_SLOTS = 0


choice ZMK_BEHAVIOR_DYNAMIC_MACRO_FEEDBACK_LEVEL_CHOICE
    prompt "Typed feedback level"
    default ZMK_BEHAVIOR_DYNAMIC_MACRO_FEEDBACK_VERBOSE

config ZMK_BEHAVIOR_DYNAMIC_MACRO_FEEDBACK_OFF
    bool "Off"

config ZMK_BEHAVIOR_DYNAMIC_MACRO_FEEDBACK_ERROR
    bool "Errors only"

config ZMK_BEHAVIOR_DYNAMIC_MACRO_FEEDBACK_COMMAND
    bool "Commands (no empty slot messages)"

config ZMK_BEHAVIOR_DYNAMIC_MACRO_FEEDBACK_BASIC
    bool "Basic"

config ZMK_BEHAVIOR_DYNAMIC_MACRO_FEEDBACK_VERBOSE
    bool "Verbose"

endchoice

config ZMK_BEHAVIOR_DYNAMIC_MACRO_FEEDBACK_LEVEL
    int
    default 0 if ZMK_BEHAVIOR_DYNAMIC_MACRO_FEEDBACK_OFF
    default 1 if ZMK_BEHAVIOR_DYNAMIC_MACRO_FEEDBACK_ERROR
    default 2 if ZMK_BEHAVIOR_DYNAMIC_MACRO_FEEDBACK_COMMAND
    default 3 if ZMK_BEHAVIOR_DYNAMIC_MACRO_FEEDBACK_BASIC
    default 4 if ZMK_BEHAVIOR_DYNAMIC_MACRO_FEEDBACK_VERBOSE

choice ZMK_BEHAVIOR_DYNAMIC_MACRO_LOCALE_CHOICE
    prompt "Host keyboard locale for typed feedback"
    default ZMK_BEHAVIOR_DYNAMIC_MACRO_LOCALE_US
    depends on !ZMK_BEHAVIOR_DYNAMIC_MACRO_FEEDBACK_OFF
    help
      Select host keyboard layout. US QWERTY enables full punctuated output.
      Other locales use plain mode (letters, digits, space only) with correct
      character mapping for that layout.

config ZMK_BEHAVIOR_DYNAMIC_MACRO_LOCALE_US
    bool "US QWERTY (full punctuation)"

config ZMK_BEHAVIOR_DYNAMIC_MACRO_LOCALE_UK
    bool "UK QWERTY (full punctuation)"

config ZMK_BEHAVIOR_DYNAMIC_MACRO_LOCALE_DE
    bool "German QWERTZ (plain mode)"

config ZMK_BEHAVIOR_DYNAMIC_MACRO_LOCALE_FR
    bool "French AZERTY (plain mode)"

endchoice

config ZMK_BEHAVIOR_DYNAMIC_MACRO_LOCALE
    int
    default 0 if ZMK_BEHAVIOR_DYNAMIC_MACRO_LOCALE_US
    default 1 if ZMK_BEHAVIOR_DYNAMIC_MACRO_LOCALE_UK
    default 2 if ZMK_BEHAVIOR_DYNAMIC_MACRO_LOCALE_DE
    default 3 if ZMK_BEHAVIOR_DYNAMIC_MACRO_LOCALE_FR
    default 0

choice ZMK_BEHAVIOR_DYNAMIC_MACRO_FEEDBACK_STYLE_CHOICE
    prompt "Typed feedback style"
    default ZMK_BEHAVIOR_DYNAMIC_MACRO_FEEDBACK_STYLE_FULL
    depends on !ZMK_BEHAVIOR_DYNAMIC_MACRO_FEEDBACK_OFF

config ZMK_BEHAVIOR_DYNAMIC_MACRO_FEEDBACK_STYLE_FULL
    bool "Full text ([DM REC], [DM SAVED N3])"

config ZMK_BEHAVIOR_DYNAMIC_MACRO_FEEDBACK_STYLE_ARROW
    bool "Arrow grammar (>*, >N3, -N3)"
    depends on ZMK_BEHAVIOR_DYNAMIC_MACRO_LOCALE_US || ZMK_BEHAVIOR_DYNAMIC_MACRO_LOCALE_UK

endchoice

config ZMK_BEHAVIOR_DYNAMIC_MACRO_FEEDBACK_STYLE
    int
    default 0 if ZMK_BEHAVIOR_DYNAMIC_MACRO_FEEDBACK_STYLE_FULL
    default 1 if ZMK_BEHAVIOR_DYNAMIC_MACRO_FEEDBACK_STYLE_ARROW
    default 0

config ZMK_BEHAVIOR_DYNAMIC_MACRO_FEEDBACK_AUTO_ERASE
    bool "Auto-erase feedback after display"
    default n
    depends on !ZMK_BEHAVIOR_DYNAMIC_MACRO_FEEDBACK_OFF
    help
      Automatically delete typed feedback output after a configurable delay
      by emitting backspace keycodes. Cancelled if user types before the
      delay expires. Multi-line status output is excluded.

config ZMK_BEHAVIOR_DYNAMIC_MACRO_FEEDBACK_ERASE_DELAY
    int "Auto-erase delay in ms"
    default 1500
    range 500 10000
    depends on ZMK_BEHAVIOR_DYNAMIC_MACRO_FEEDBACK_AUTO_ERASE

choice ZMK_BEHAVIOR_DYNAMIC_MACRO_STATUS_DETAIL_CHOICE
    prompt "Status key output detail"
    default ZMK_BEHAVIOR_DYNAMIC_MACRO_STATUS_FULL if ZMK_BEHAVIOR_DYNAMIC_MACRO_FEEDBACK_VERBOSE
    default ZMK_BEHAVIOR_DYNAMIC_MACRO_STATUS_USED_PREVIEW if ZMK_BEHAVIOR_DYNAMIC_MACRO_FEEDBACK_BASIC
    default ZMK_BEHAVIOR_DYNAMIC_MACRO_STATUS_USED_PREVIEW if ZMK_BEHAVIOR_DYNAMIC_MACRO_FEEDBACK_COMMAND
    default ZMK_BEHAVIOR_DYNAMIC_MACRO_STATUS_USED if ZMK_BEHAVIOR_DYNAMIC_MACRO_FEEDBACK_ERROR
    default ZMK_BEHAVIOR_DYNAMIC_MACRO_STATUS_OFF
    help
      Controls output detail when pressing the STATUS key. Defaults follow
      feedback level but can be overridden independently.

config ZMK_BEHAVIOR_DYNAMIC_MACRO_STATUS_OFF
    bool "Off (no status output)"

config ZMK_BEHAVIOR_DYNAMIC_MACRO_STATUS_COUNT
    bool "Count only (filled/total)"

config ZMK_BEHAVIOR_DYNAMIC_MACRO_STATUS_USED
    bool "Used slots (no preview)"

config ZMK_BEHAVIOR_DYNAMIC_MACRO_STATUS_USED_PREVIEW
    bool "Used slots with preview"

config ZMK_BEHAVIOR_DYNAMIC_MACRO_STATUS_FULL
    bool "Full listing (all slots)"

endchoice

config ZMK_BEHAVIOR_DYNAMIC_MACRO_STATUS_DETAIL
    int
    default 0 if ZMK_BEHAVIOR_DYNAMIC_MACRO_STATUS_OFF
    default 1 if ZMK_BEHAVIOR_DYNAMIC_MACRO_STATUS_COUNT
    default 2 if ZMK_BEHAVIOR_DYNAMIC_MACRO_STATUS_USED
    default 3 if ZMK_BEHAVIOR_DYNAMIC_MACRO_STATUS_USED_PREVIEW
    default 4 if ZMK_BEHAVIOR_DYNAMIC_MACRO_STATUS_FULL

config ZMK_BEHAVIOR_DYNAMIC_MACRO_TEST_RELOAD
    bool "Test-only: DM_TEST_RELOAD command to simulate NVS reboot"
    default n
    depends on ZMK_BEHAVIOR_DYNAMIC_MACRO_PERSIST
    help
      Adds a DM_TEST_RELOAD command that zeroes all slot data in RAM
      and reloads from NVS settings, simulating a power cycle.
      For testing only.

config ZMK_BEHAVIOR_DYNAMIC_MACRO_EVENTS
    bool "Enable event notifications for display widgets"
    default n
    help
      Broadcasts ZMK events on state changes (recording, playback, save, etc.)
      for external display widgets to subscribe to. Also enables query API for
      slot contents.

endif
```

## dts/bindings/behaviors/zmk,behavior-dynamic-macro.yaml
```yaml
# Copyright (c) 2026 The ZMK Contributors
# SPDX-License-Identifier: MIT

description: |
  Dynamic Macro behavior for recording and playing back key sequences.
  param1 selects the command, param2 provides the slot index (for slot commands).

  Commands (param1):
    0 (DM_REC)      - Start recording
    1 (DM_STP)      - Stop recording
    2 (DM_DEL)      - Delete mode
    3 (DM_STATE)    - Show status
    4 (DM_MOV)      - Move mode
    5 (DM_SLOT_NVS) - NVS slot (play/assign)
    6 (DM_SLOT_RAM) - RAM slot (play/assign)
    7 (DM_PREVIEW)  - Preview mode

compatible: "zmk,behavior-dynamic-macro"

include: two_param.yaml
```

## tests/parity/render/testcase.yaml
```yaml
# Twister case for the render-parity capture test (redesign §5.2).
# Runs as native_sim; its product is the golden strings printed to the log,
# captured from the live old dm_get_preview_string.
tests:
  zmk.behavior.dynamic_macro.parity.render_capture:
    platform_allow:
      - native_sim
    integration_platforms:
      - native_sim
    tags:
      - dynamic_macro
      - parity
    harness: test
    # app.overlay in this dir is auto-applied by Twister (native_sim board);
    # it instantiates the &dm node so the behavior + EVENTS query API compile in.
```

## tests/size/boards/shields/dm_size/Kconfig.defconfig
```kconfig
# Copyright (c) 2026 Benjamin H
# SPDX-License-Identifier: MIT

if SHIELD_DM_SIZE

config ZMK_KEYBOARD_NAME
    default "DM SIZE"

# Keep the firmware minimal and deterministic so the measured delta is the
# dynamic-macro module's code, not unrelated subsystems. BLE/display add large,
# config-independent blocks that would swamp the module's contribution.
config ZMK_BLE
    default n

config ZMK_USB
    default y

config ZMK_DISPLAY
    default n

endif
```

## tests/size/boards/shields/dm_size/Kconfig.shield
```kconfig
# Copyright (c) 2026 Benjamin H
# SPDX-License-Identifier: MIT

config SHIELD_DM_SIZE
    def_bool $(shields_list_contains,dm_size)
```

## tests/size/west.yml
```yaml
# West manifest for the firmware-size workspace. ZMK (with its Zephyr) only —
# this module is NOT a `self` project here; the workflow points the build at the
# checked-out module via ZMK_EXTRA_MODULES. Keeping the manifest module-free lets
# the workspace live in an isolated temp dir (the proven urob/zmk-actions pattern)
# without the module nesting under it.
manifest:
  remotes:
    - name: zmkfirmware
      url-base: https://github.com/zmkfirmware
  projects:
    - name: zmk
      remote: zmkfirmware
      revision: main
      import: app/west.yml
  self:
    path: config
```

## tests/unit/testcase.yaml
```yaml
# Twister test case for the pure-core unit suite (redesign §4.1).
# Built as native_sim under `west test`, alongside the snapshot suite.
tests:
  zmk.behavior.dynamic_macro.unit:
    platform_allow:
      - native_sim
    integration_platforms:
      - native_sim
    tags:
      - dynamic_macro
      - unit
    harness: test
```
