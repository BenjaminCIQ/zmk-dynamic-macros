#include "behavior_keymap.dtsi"

&kscan {
    events = <
        /* REC */
        ZMK_MOCK_PRESS(0,0,10)
        ZMK_MOCK_RELEASE(0,0,2000)
        /* Ctrl+C (recorded -> token <LCTL+C>) */
        ZMK_MOCK_PRESS(2,0,10)
        ZMK_MOCK_RELEASE(2,0,10)
        /* Shift+3 (recorded -> '#' on US) */
        ZMK_MOCK_PRESS(2,1,10)
        ZMK_MOCK_RELEASE(2,1,10)
        /* STP */
        ZMK_MOCK_PRESS(0,1,10)
        ZMK_MOCK_RELEASE(0,1,2000)
        /* SLOT_RAM 0 (assign -> VERBOSE save types "[DM SAVED R...: '<LCTL+C>#'") */
        ZMK_MOCK_PRESS(1,0,10)
        ZMK_MOCK_RELEASE(1,0,4000)
    >;
};
