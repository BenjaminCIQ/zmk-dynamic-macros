/* GENERATED by tests/parity/e2e/generate.sh — do not edit. */
/* Parity: same input as tests/feedback/status_accuracy, new stack, same snapshot. */
#include "../../../feedback/status_accuracy/native_sim.keymap"
