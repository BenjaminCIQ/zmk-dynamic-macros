/* GENERATED by tests/parity/e2e/generate.sh — do not edit. */
/* Parity: same input as tests/core/chain_no_room, new stack, same snapshot. */
#include "../../../core/chain_no_room/native_sim.keymap"
