/* GENERATED by tests/parity/e2e/generate.sh — do not edit. */
/* Parity: same input as tests/events/nvs_delete_events, new stack, same snapshot. */
#include "../../../events/nvs_delete_events/native_sim.keymap"
