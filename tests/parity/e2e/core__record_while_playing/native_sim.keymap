/* GENERATED by tests/parity/e2e/generate.sh — do not edit. */
/* Parity: same input as tests/core/record_while_playing, new stack, same snapshot. */
#include "../../../core/record_while_playing/native_sim.keymap"
