/* GENERATED by tests/parity/e2e/generate.sh — do not edit. */
/* Parity: same input as tests/feedback/erase_toggle, new stack, same snapshot. */
#include "../../../feedback/erase_toggle/native_sim.keymap"
