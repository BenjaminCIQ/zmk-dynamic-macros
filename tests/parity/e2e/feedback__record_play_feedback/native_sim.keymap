/* GENERATED by tests/parity/e2e/generate.sh — do not edit. */
/* Parity: same input as tests/feedback/record_play_feedback, new stack, same snapshot. */
#include "../../../feedback/record_play_feedback/native_sim.keymap"
