/* GENERATED by tests/parity/e2e/generate.sh — do not edit. */
/* Parity: same input as tests/core/assign_occupied, new stack, same snapshot. */
#include "../../../core/assign_occupied/native_sim.keymap"
