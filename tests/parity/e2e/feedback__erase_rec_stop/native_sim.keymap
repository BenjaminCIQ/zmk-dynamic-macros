/* GENERATED by tests/parity/e2e/generate.sh — do not edit. */
/* Parity: same input as tests/feedback/erase_rec_stop, new stack, same snapshot. */
#include "../../../feedback/erase_rec_stop/native_sim.keymap"
