/* GENERATED by tests/parity/e2e/generate.sh — do not edit. */
/* Parity: same input as tests/core/move_occupied, new stack, same snapshot. */
#include "../../../core/move_occupied/native_sim.keymap"
