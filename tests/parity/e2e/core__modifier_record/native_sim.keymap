/* GENERATED by tests/parity/e2e/generate.sh — do not edit. */
/* Parity: same input as tests/core/modifier_record, new stack, same snapshot. */
#include "../../../core/modifier_record/native_sim.keymap"
