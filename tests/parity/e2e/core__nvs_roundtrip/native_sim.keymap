/* GENERATED by tests/parity/e2e/generate.sh — do not edit. */
/* Parity: same input as tests/core/nvs_roundtrip, new stack, same snapshot. */
#include "../../../core/nvs_roundtrip/native_sim.keymap"
