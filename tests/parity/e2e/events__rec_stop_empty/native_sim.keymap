/* GENERATED by tests/parity/e2e/generate.sh — do not edit. */
/* Parity: same input as tests/events/rec_stop_empty, new stack, same snapshot. */
#include "../../../events/rec_stop_empty/native_sim.keymap"
