/* GENERATED by tests/parity/e2e/generate.sh — do not edit. */
/* Parity: same input as tests/feedback/style_toggle, new stack, same snapshot. */
#include "../../../feedback/style_toggle/native_sim.keymap"
