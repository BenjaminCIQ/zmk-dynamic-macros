/* GENERATED by tests/parity/e2e/generate.sh — do not edit. */
/* Parity: same input as tests/core/delete_cancel, new stack, same snapshot. */
#include "../../../core/delete_cancel/native_sim.keymap"
