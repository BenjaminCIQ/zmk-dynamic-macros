/* GENERATED by tests/parity/e2e/generate.sh — do not edit. */
/* Parity: same input as tests/core/record_timeout, new stack, same snapshot. */
#include "../../../core/record_timeout/native_sim.keymap"
