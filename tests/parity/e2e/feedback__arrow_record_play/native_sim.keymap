/* GENERATED by tests/parity/e2e/generate.sh — do not edit. */
/* Parity: same input as tests/feedback/arrow_record_play, new stack, same snapshot. */
#include "../../../feedback/arrow_record_play/native_sim.keymap"
