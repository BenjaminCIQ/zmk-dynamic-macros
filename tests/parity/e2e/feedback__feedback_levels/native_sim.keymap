/* GENERATED by tests/parity/e2e/generate.sh — do not edit. */
/* Parity: same input as tests/feedback/feedback_levels, new stack, same snapshot. */
#include "../../../feedback/feedback_levels/native_sim.keymap"
