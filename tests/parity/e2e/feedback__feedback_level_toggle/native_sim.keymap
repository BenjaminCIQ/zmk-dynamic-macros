/* GENERATED by tests/parity/e2e/generate.sh — do not edit. */
/* Parity: same input as tests/feedback/feedback_level_toggle, new stack, same snapshot. */
#include "../../../feedback/feedback_level_toggle/native_sim.keymap"
