/* GENERATED by tests/parity/e2e/generate.sh — do not edit. */
/* Parity: same input as tests/core/nvs_delete_reload, new stack, same snapshot. */
#include "../../../core/nvs_delete_reload/native_sim.keymap"
