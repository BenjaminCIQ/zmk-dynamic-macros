/* GENERATED by tests/parity/e2e/generate.sh — do not edit. */
/* Parity: same input as tests/core/move_last_empty, new stack, same snapshot. */
#include "../../../core/move_last_empty/native_sim.keymap"
