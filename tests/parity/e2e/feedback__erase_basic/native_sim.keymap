/* GENERATED by tests/parity/e2e/generate.sh — do not edit. */
/* Parity: same input as tests/feedback/erase_basic, new stack, same snapshot. */
#include "../../../feedback/erase_basic/native_sim.keymap"
