/* GENERATED by tests/parity/e2e/generate.sh — do not edit. */
/* Parity: same input as tests/core/assign_cancel, new stack, same snapshot. */
#include "../../../core/assign_cancel/native_sim.keymap"
