/* GENERATED by tests/parity/e2e/generate.sh — do not edit. */
/* Parity: same input as tests/events/record_play_events, new stack, same snapshot. */
#include "../../../events/record_play_events/native_sim.keymap"
