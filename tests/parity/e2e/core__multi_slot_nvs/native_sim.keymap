/* GENERATED by tests/parity/e2e/generate.sh — do not edit. */
/* Parity: same input as tests/core/multi_slot_nvs, new stack, same snapshot. */
#include "../../../core/multi_slot_nvs/native_sim.keymap"
