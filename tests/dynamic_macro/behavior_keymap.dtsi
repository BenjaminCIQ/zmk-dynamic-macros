/*
 * Copyright (c) 2026 The ZMK Contributors
 * SPDX-License-Identifier: MIT
 *
 * Shared behavior instance for dynamic macro tests.
 */

#include <dt-bindings/zmk/keys.h>
#include <behaviors.dtsi>
#include <dt-bindings/zmk/kscan_mock.h>
#include <behaviors/dynamic_macro.dtsi>
#include <dt-bindings/zmk/dynamic_macros.h>

/ {
    chosen {
        zmk,kscan = &kscan;
    };

    kscan: kscan {
        compatible = "zmk,kscan-mock";
        rows = <2>;
        columns = <2>;
        exit-after;
    };
};
