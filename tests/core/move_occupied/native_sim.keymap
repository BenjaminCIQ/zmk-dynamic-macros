#include "../behavior_keymap.dtsi"

&kscan {
    events = <
        /* Record A into slot 0 */
        ZMK_MOCK_PRESS(0,0,10)
        ZMK_MOCK_RELEASE(0,0,10)
        ZMK_MOCK_PRESS(3,0,10)
        ZMK_MOCK_RELEASE(3,0,10)
        ZMK_MOCK_PRESS(0,1,10)
        ZMK_MOCK_RELEASE(0,1,10)
        ZMK_MOCK_PRESS(1,0,10)
        ZMK_MOCK_RELEASE(1,0,10)
        /* Record B into slot 1 */
        ZMK_MOCK_PRESS(0,0,10)
        ZMK_MOCK_RELEASE(0,0,10)
        ZMK_MOCK_PRESS(3,1,10)
        ZMK_MOCK_RELEASE(3,1,10)
        ZMK_MOCK_PRESS(0,1,10)
        ZMK_MOCK_RELEASE(0,1,10)
        ZMK_MOCK_PRESS(1,1,10)
        ZMK_MOCK_RELEASE(1,1,10)
        /* MOV: try to move slot 0 -> slot 1 (occupied, rejected) */
        ZMK_MOCK_PRESS(2,1,10)
        ZMK_MOCK_RELEASE(2,1,10)
        ZMK_MOCK_PRESS(1,0,10)
        ZMK_MOCK_RELEASE(1,0,10)
        ZMK_MOCK_PRESS(1,1,10)
        ZMK_MOCK_RELEASE(1,1,10)
        /* Play slot 0: should still be A */
        ZMK_MOCK_PRESS(1,0,2000)
        ZMK_MOCK_RELEASE(1,0,10)
        /* Play slot 1: should still be B */
        ZMK_MOCK_PRESS(1,1,2000)
        ZMK_MOCK_RELEASE(1,1,10)
    >;
};
