#include "../behavior_keymap.dtsi"

&kscan {
    events = <
        /* DEL on already-empty slot 0 */
        ZMK_MOCK_PRESS(2,0,10)
        ZMK_MOCK_RELEASE(2,0,10)
        ZMK_MOCK_PRESS(1,0,10)
        ZMK_MOCK_RELEASE(1,0,10)
        /* Should return to IDLE; verify by recording normally after */
        ZMK_MOCK_PRESS(0,0,10)
        ZMK_MOCK_RELEASE(0,0,10)
        ZMK_MOCK_PRESS(3,0,10)
        ZMK_MOCK_RELEASE(3,0,10)
        ZMK_MOCK_PRESS(0,1,10)
        ZMK_MOCK_RELEASE(0,1,10)
        ZMK_MOCK_PRESS(1,0,10)
        ZMK_MOCK_RELEASE(1,0,10)
        /* Play slot 0: should be A */
        ZMK_MOCK_PRESS(1,0,2000)
        ZMK_MOCK_RELEASE(1,0,10)
    >;
};
