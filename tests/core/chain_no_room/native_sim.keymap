#include "../behavior_keymap.dtsi"

&kscan {
    events = <
        /* Record A+B (4 events = full buffer) into slot 0 */
        ZMK_MOCK_PRESS(0,0,10)
        ZMK_MOCK_RELEASE(0,0,10)
        ZMK_MOCK_PRESS(3,0,10)
        ZMK_MOCK_RELEASE(3,0,10)
        ZMK_MOCK_PRESS(3,1,10)
        ZMK_MOCK_RELEASE(3,1,10)
        ZMK_MOCK_PRESS(0,1,10)
        ZMK_MOCK_RELEASE(0,1,10)
        ZMK_MOCK_PRESS(1,0,10)
        ZMK_MOCK_RELEASE(1,0,10)
        /* New recording: record A (2 events), then chain slot 0 (4 events, no room) */
        ZMK_MOCK_PRESS(0,0,10)
        ZMK_MOCK_RELEASE(0,0,10)
        ZMK_MOCK_PRESS(3,0,10)
        ZMK_MOCK_RELEASE(3,0,10)
        ZMK_MOCK_PRESS(1,0,10)
        ZMK_MOCK_RELEASE(1,0,10)
        /* Should still be recording; stop and assign to slot 1 */
        ZMK_MOCK_PRESS(0,1,10)
        ZMK_MOCK_RELEASE(0,1,10)
        ZMK_MOCK_PRESS(1,1,10)
        ZMK_MOCK_RELEASE(1,1,10)
        /* Play slot 1: should be just A (chain was rejected) */
        ZMK_MOCK_PRESS(1,1,2000)
        ZMK_MOCK_RELEASE(1,1,10)
    >;
};
