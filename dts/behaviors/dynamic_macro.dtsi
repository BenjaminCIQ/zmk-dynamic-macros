/*
 * Copyright (c) 2026 Benjamin H
 *
 * SPDX-License-Identifier: MIT
 */

/ {
    behaviors {
        dm: dynamic_macro {
            compatible = "zmk,behavior-dynamic-macro";
            #binding-cells = <2>;
            display-name = "Dynamic Macro";
        };
    };
};
